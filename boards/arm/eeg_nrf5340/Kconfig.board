## boards/arm/eeg_nrf5340/Kconfig.board
```kconfig
# EEG NRF5340 board configuration

# Copyright (c) 2019-2020 Nordic Semiconductor ASA
# SPDX-License-Identifier: Apache-2.0

if SOC_NRF5340_CPUAPP_QKAA

config BOARD_EEG_NRF5340_CPUAPP
	bool "EEG nRF5340 Application MCU"

config BOARD_EEG_NRF5340_CPUAPP_NS
	bool "EEG nRF5340 Application MCU non-secure"

endif # SOC_NRF5340_CPUAPP_QKAA

config BOARD_EEG_NRF5340_CPUNET
	bool "EEG NRF5340 Network MCU"
	depends on SOC_NRF5340_CPUNET_QKAA
```

## boards/arm/eeg_nrf5340/eeg_nrf5340_cpunet_defconfig
```kconfig
# SPDX-License-Identifier: Apache-2.0

CONFIG_SOC_SERIES_NRF53X=y
CONFIG_SOC_NRF5340_CPUNET_QKAA=y
CONFIG_BOARD_EEG_NRF5340_CPUNET=y

# Enable MPU
CONFIG_ARM_MPU=y

# Enable hardware stack protection
CONFIG_HW_STACK_PROTECTION=y

CONFIG_BT_CTLR=y
CONFIG_BT_CTLR_TX_PWR_PLUS_3=y
```

## ti_ads1299_driver/dts/bindings/ti,ads1299.yaml
```yaml
# Copyright (c) 2024 HHS
description: Texas Instruments ADS1299 Analog-to-Digital Converter

compatible: "ti,ads1299"

include: spi-device.yaml

properties:
  drdy-gpios:
    type: phandle-array
    required: true
    description: Data Ready pin

  start-gpios:
    type: phandle-array
    required: false
    description: Start pin
```

## ti_ads1299_driver/zephyr/Kconfig
```kconfig
# ADS1299 driver options

# Copyright (c) 2024 HHS

menuconfig TI_ADS1299_DRIVER
	bool "Support for the demonstration out of tree custom BME280 driver using SPI"
	depends on SPI


if TI_ADS1299_DRIVER

source "subsys/logging/Kconfig.template.log_config"
# STEP 3 - Add a custom driver initialization priority
config DRIVER_INIT_PRIORITY
	int "Init priority"
	default 71
	help
	  Custom device driver initialization priority, needs be more higher than CONFIG_SPI_INIT_PRIORITY.


endif
```
